#pragma once
#include "ram.h"

#define dtb_start  0x3ff000
#define dtb_end   0x3ff5c0
#define kernel_start  0x200000
#define kernel_end  0x3c922c

static uint8_t default64mbdtb[] = {
0xd0, 0x0d, 0xfe, 0xed, 0x00, 0x00, 0x06, 0x00, 0x00, 0x00, 0x00, 0x38, 0x00, 0x00, 0x05, 0x00,
0x00, 0x00, 0x00, 0x28, 0x00, 0x00, 0x00, 0x11, 0x00, 0x00, 0x00, 0x10, 0x00, 0x00, 0x00, 0x00,
0x00, 0x00, 0x00, 0xe3, 0x00, 0x00, 0x04, 0xc8, 0x00, 0x00, 0x00, 0x00, 0x00, 0x00, 0x00, 0x00,
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0x00, 0x00, 0x00, 0x00, 0x00, 0x00, 0x00, 0x00, 0x00, 0x00, 0x00, 0x00, 0x00, 0x00, 0x00, 0x00,
};

static uint32_t ram_amt = 8 * 1024 * 1024;
#define MINIRV32_RAM_IMAGE_OFFSET  0x80000000

#define MINIRV32WARN(x...) Serial.println(x);
#define MINI_RV32_RAM_SIZE ram_amt
#define MINIRV32_IMPLEMENTATION
#define MINIRV32_POSTEXEC(pc, ir, retval) { if (retval > 0) {  retval = HandleException(ir, retval); } }
#define MINIRV32_HANDLE_MEM_STORE_CONTROL(addy, val) if (HandleControlStore(addy, val)) return val;
#define MINIRV32_HANDLE_MEM_LOAD_CONTROL(addy, rval) rval = HandleControlLoad(addy);
#define MINIRV32_OTHERCSR_WRITE(csrno, value) HandleOtherCSRWrite(image, csrno, value);
#define MINIRV32_OTHERCSR_READ(csrno, value) value = HandleOtherCSRRead(image, csrno);

#define MINIRV32_CUSTOM_MEMORY_BUS
#define MINIRV32_STORE4( ofs, val ) store4(ofs, val)
#define MINIRV32_STORE2( ofs, val ) store2(ofs, val)
#define MINIRV32_STORE1( ofs, val ) store1(ofs, val)
#define MINIRV32_LOAD4( ofs ) load4(ofs)
#define MINIRV32_LOAD2( ofs ) load2(ofs)
#define MINIRV32_LOAD1( ofs ) load1(ofs)

static uint32_t HandleException(uint32_t ir, uint32_t code)
{
  // Weird opcode emitted by duktape on exit.
  if (code == 3) {
    // Could handle other opcodes here.
  }
  return code;
}

static uint32_t HandleControlStore(uint32_t addy, uint32_t val)
{
  //UART 8250 / 16550 Data Buffer
  if (addy == 0x10000000) {
        // ESP_LOGI(TAG, "%s", (char*) &val);
    Serial.print((char*)&val);
    // while (usb_serial_jtag_ll_write_txfifo((uint8_t *)&val, 1) < 1) ;
    // usb_serial_jtag_ll_txfifo_flush();
  }
  return 0;
}

static uint32_t HandleControlLoad(uint32_t addy)
{
  // Emulating a 8250 / 16550 UART
  if (addy == 0x10000005)
    return 0x60 | Serial.available() > 0;
  else if (addy == 0x10000000 && Serial.available() > 0)
    return Serial.read();
  return 0;
}

static void HandleOtherCSRWrite(uint8_t *image, uint16_t csrno, uint32_t value)
{
  uint32_t ptrstart, ptrend;

  switch (csrno) {
  case 0x136:
    Serial.print((int)value, DEC);
    break;
  case 0x137:
    Serial.print((int)value, HEX);
    break;
  case 0x138:
    //Print "string"
    ptrstart = value - MINIRV32_RAM_IMAGE_OFFSET;
    ptrend = ptrstart;
    if (ptrstart >= ram_amt)
      Serial.println("DEBUG PASSED INVALID PTR (%)\n");
    while (ptrend < ram_amt) {
      uint8_t c = MINIRV32_LOAD1(ptrend);
      if (c == 0)
        break;
      Serial.print((char)c);
      ptrend++;
    }
    break;
  case 0x139:
    Serial.print((char)value);
    break;
  default:
    break;
  }
}

static int32_t HandleOtherCSRRead(uint8_t *image, uint16_t csrno)
{
  if (csrno == 0x140) {
//    if (!IsKBHit())
      return -1;
//    return ReadKBByte();
  }
  return 0;
}
